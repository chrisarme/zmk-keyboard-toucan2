## dts/bindings/behaviors/zmk,behavior-toucan-artwork.yaml
```yaml
description: Select or cycle the Toucan fullscreen artwork

compatible: "zmk,behavior-toucan-artwork"

include: one_param.yaml
```

## dts/bindings/behaviors/zmk,behavior-toucan-screen.yaml
```yaml
description: Select or cycle the Toucan status screen

compatible: "zmk,behavior-toucan-screen"

include: one_param.yaml
```
